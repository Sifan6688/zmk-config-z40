## config/boards/shields/z40/Kconfig.defconfig
```kconfig
# Copyright (c) 2020 The ZMK Contributors
# SPDX-License-Identifier: MIT

if SHIELD_z40

config ZMK_KEYBOARD_NAME
    default "z40"

endif
```
